## west.yml
```yaml
# The west manifest file (west.yml) for MCUXpresso SDK delivery.
#
# See the west documentation for more information:
#
# https://docs.zephyrproject.org/latest/guides/west/index.html
manifest:
  remotes:
    - name: nxp
      url-base: https://github.com/NXP
    - name: nxp-zephyr
      url-base: https://github.com/nxp-zephyr
    - name: nxp-mcuxpresso
      url-base: https://github.com/nxp-mcuxpresso
  defaults:
    remote: nxp-mcuxpresso
  group-filter:
    - -optional
    - -bifrost
    - -ble_cs_algo_private
    - -bluetooth_private
  projects:
    - name: bifrost
      path: bifrost
      remote: nxp-zephyr
      revision: main
      west-commands: scripts/west_commands.yml
      groups:
        - bifrost
    - name: core
      path: mcuxsdk/
      repo-path: mcuxsdk-core
      revision: 7599a858252dafa23467fd81eb172fb2395b35d1
      west-commands: scripts/west_commands.yml
    - name: psa_crypto_driver
      url: https://github.com/NXP/psa_crypto_driver
      path: mcuxsdk/components/psa_crypto_driver
      revision: 826a7cba1a90aab596b9d7fce5718d9c9611dabb
    - name: mcu-sdk-examples
      repo-path: mcuxsdk-examples
      path: mcuxsdk/examples
      revision: 1c5385819defc787e55b4e19a1c6ae0ac4900611
    - name: wifi_nxp
      url: https://github.com/NXP/wifi_nxp
      path: mcuxsdk/middleware/wifi_nxp
      revision: 0036f351323f2446a6e6ce9cf4079862cb934d95
    - name: lwip
      url: https://github.com/nxp-mcuxpresso/lwip
      path: mcuxsdk/middleware/lwip
      revision: a5bc68f1b34f3b407a71e588bbca46091fd506a3
    - name: mcuxsdk-manifests
      repo-path: mcuxsdk-manifests
      path: manifests
      revision: v26.06.00
      import: true
    - name: matter
      remote: nxp
      repo-path: matter
      revision: fe060cfe7bcbd20df2fa42364d8277c9913133a7
      path: mcuxsdk/middleware/matter
      submodules:
        - name: nlio
          path: third_party/nlio/repo
        - name: nlassert
          path: third_party/nlassert/repo
        - name: pigweed
          path: third_party/pigweed/repo
        - name: jsoncpp
          path: third_party/jsoncpp/repo
        - name: nxp_matter_support
          path: third_party/nxp/nxp_matter_support
        - name: ot-nxp
          path: third_party/openthread/ot-nxp
        - name: simw-top-mini
          path: third_party/simw-top-mini/repo
        - name: uriparser
          path: third_party/uriparser/repo
    - name: mcu-sdk-examples-matter
      repo-path: mcuxsdk-examples-matter
      path: mcuxsdk/examples/matter_examples
      revision: b7ff81dda12300169d33d4f5fc64559ab9b256d4
```
